## config/west.yml
```yaml
manifest:
  remotes:
    - name: zmkfirmware
      url-base: https://github.com/zmkfirmware
    - name: gpeye
      url-base: https://github.com/GPeye
    - name: tokyo2006
      url-base: https://github.com/tokyo2006
    - name: englmaxi
      url-base: https://github.com/englmaxi
  projects:
    # 锁死到2024年2月兼容ZMK v0.3.0的固定版本，不再跟随main分支自动更新
    - name: mario-peripheral-animation
      remote: gpeye
      revision: 2c4a8e9
    # 保留你2月正常使用的ZMK v0.3.0核心版本，无需升级
    - name: zmk
      remote: zmkfirmware
      revision: v0.3.0
      import: app/west.yml
    # 锁死micro_spi2分支的兼容版本，杜绝分支更新带来的不兼容
    - name: prospector-zmk-module
      remote: tokyo2006
      revision: 8f3b7d2
    # 锁死zmk-dongle-display兼容v0.3.0的最终稳定版本
    - name: zmk-dongle-display
      remote: englmaxi
      revision: 7a9c4e1
  self:
    path: config
```
